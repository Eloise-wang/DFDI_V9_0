# AC784x register map
Vendor: AutoChips; Series: AC78; File version: 1.0
AC784x Microcontroller
CPU: CM4 r0p1, little endian, MPU, FPU, VTOR, 4 interrupt priority bits
Registers are 32-bit, read-write, reset 0x0 unless marked. A register's access mark holds for its fields unless they carry their own. Offsets are from the block's base; lines under a group give offsets from that group; [hi:lo] are bit positions; {n}, {i} and the like mark numbered series; 'fields as' and 'values as' point back to an identical list; <NAME> marks a mode.

## Memory map
0x40000000 CKGEN size 0x50 — Clock Generator
0x40000800 CMU_VHSI size 0x24 — VHSI Clock Monitor Uint
0x40000A00 CMU_HSE size 0x24
0x40000C00 CMU_PLL size 0x24
0x40002000 FLASH size 0x40 — Embedded Flash
0x40003000 ADC0 size 0x178 — Analog to Digital Converter
0x40004000 ADC1 size 0x178
0x40005000 ACMP0 size 0x34 — Analog comparator
0x40006000 CTU size 0x64 — Connect Unit Module
0x40007000 CAN0 size 0xD0 — Controller Area Network
0x40007200 CAN1 size 0xD0
0x40007400 CAN2 size 0xD0
0x40007600 CAN3 size 0xD0
0x40008000 SPM size 0x18 — System Power Manage
0x40008800 ANA size 0xCC — Analog Control Registers
0x40009800 RTC size 0x18 — Real-time counter
0x4000A000 EIO size 0xC0 — The EIO Memory Map/Register Definition can be found here.
0x4000B000 WDG size 0x10 — Watchdog
0x4000B400 EWDG size 0x14 — External Watchdog Timer
0x4000C000 SPI0 size 0x1000 — Serial Peripheral Interface
0x4000C800 SPI1 size 0x1000
0x4000D000 SPI2 size 0x1000
0x4000E000 I2C0 size 0x34 — Inter-Integrated Circuit
0x40011000 TIMER_CTRL size 0x10 — Timer Control
0x40011010 TIMER_CHANNEL size 0x10
0x40011020 TIMER_CHANNEL1 size 0x10
0x40011030 TIMER_CHANNEL2 size 0x10
0x40011040 TIMER_CHANNEL3 size 0x10
0x40012000 DMA0_TOP_RST size 0x4 — DMA0 All Channnels Share The Registers
0x40012040 DMA0_Channel0 size 0x30 — DMA channel
{0x40012040+0x40*n} DMA0_Channel{n} size 0x30 (n=1..15)
0x40018000 UART0 size 0x400 — Universal Asynchronous Receiver/Transmitter
0x40018200 UART1 size 0x400
0x40018400 UART2 size 0x400
0x40018600 UART3 size 0x400
0x40019000 PCT size 0x10 — Pulse Count Timer
0x40080000 PWM0 size 0xAC — Pulse Width Modulation
0x40080800 PWM1 size 0xAC
0x40081000 PWM2 size 0xAC
0x40081800 PWM3 size 0xAC
0x40082000 PWM4 size 0xAC
0x40082800 PWM5 size 0xAC
0x40084000 CRC size 0xC — CRC Cyclic redundancy check
0x40085000 GPIOA size 0x40 — General Purpose Input/Output
0x40085040 GPIOB size 0x40
0x40085080 GPIOC size 0x40
0x400850C0 GPIOD size 0x40
0x40085100 GPIOE size 0x40
0x40085200 PORTA size 0x100 — Pin Control and Interrupts
0x40085300 PORTB size 0x100
0x40085400 PORTC size 0x100
0x40085500 PORTD size 0x100
0x40085600 PORTE size 0x100
0x40086000 PDT0 size 0x3C — Programmable Delay Timer
0x40086800 PDT1 size 0x3C
0x40087000 MPU size 0x110 — Memory protection unit
0x40088000 EIM_CTRL size 0x8 — GLB_EN
0x40088010 EIM_CHANNEL0 size 0x10 — SRAM Error Injection Bit Control
0x40088080 EIM_CHANNEL1 size 0x10
0x40088100 ECC_SRAM size 0x14 — SRAM Error ctrl
0x40089000 SMU size 0x48 — Safety Management Uint
0x4008A000 PBR size 0x38 — Peripheral Bridge
0xE008000C MCM size 0x408 — Core Platform Miscellaneous Control Module

## Interrupts
{n} DMA0_Channel{n} (n=0..15) — DMA0 channel {n} interrupt
16 PORTA — PORTA interrupt
17 PORTB (GPIOB, PORTB) — PORTB interrupt
18 PORTC (GPIOC, PORTC) — PORTC interrupt
19 PORTD (GPIOD, PORTD) — PORTD interrupt
20 PORTE (GPIOE, PORTE) — PORTE interrupt
21 UART0 — UART0 interrupt
22 UART1 — UART1 interrupt
23 UART2 — UART2 interrupt
24 UART3 — UART3 interrupt
27 SPI0 — SPI0 interrupt
28 SPI1 — SPI1 interrupt
29 SPI2 — SPI2 interrupt
31 I2C0 — I2C0 Interrupt
33 EIO
34 CAN0 — CAN0 interrupt
35 CAN0_WAKEUP (CAN0) — CAN0 wakeup interrupt
36 CAN1 — CAN1 interrupt
37 CAN1_WAKEUP (CAN1) — CAN1 wakeup interrupt
38 CAN2 — CAN2 interrupt
39 CAN2_WAKEUP (CAN2) — CAN2 wakeup interrupt
40 CAN3 — CAN3 interrupt
41 CAN3_WAKEUP (CAN3) — CAN3 wakeup interrupt
46 PDT0 — PDT0 interrupt
47 PDT1 — PDT1 interrupt
48 ADC0 — ADC0 interrupt
49 ADC1 — ADC1 interrupt
50 ACMP0 — ACMP0 interrupt
51 WDG — WDG interrupt
52 EWDG — EWDG interrupt
53 MCM — MCM interrupt
55 SPM — SPM interrupt
56 RCM (CKGEN) — RCM interrupt
57 PWM0_OVERFLOW (PWM0) — PWM0 OVERFLOW interrupt
58 PWM0_CHANNEL (PWM0) — PWM0 CHANNEL interrupt
59 PWM0_FAULT (PWM0) — PWM0 FAULT interrupt
60 PWM1_OVERFLOW (PWM1) — PWM1 OVERFLOW interrupt
61 PWM1_CHANNEL (PWM1) — PWM1 CHANNEL interrupt
62 PWM1_FAULT (PWM1) — PWM1 FAULT interrupt
63 PWM2_OVERFLOW (PWM2) — PWM2 OVERFLOW interrupt
64 PWM2_CHANNEL (PWM2) — PWM2 CHANNEL interrupt
65 PWM2_FAULT (PWM2) — PWM2 FAULT interrupt
66 PWM3_OVERFLOW (PWM3) — PWM3 OVERFLOW interrupt
67 PWM3_CHANNEL (PWM3) — PWM3 CHANNEL interrupt
68 PWM3_FAULT (PWM3) — PWM3 FAULT interrupt
69 PWM4_OVERFLOW (PWM4) — PWM4 OVERFLOW interrupt
70 PWM4_CHANNEL (PWM4) — PWM4 CHANNEL interrupt
71 PWM4_FAULT (PWM4) — PWM4 FAULT interrupt
72 PWM5_OVERFLOW (PWM5) — PWM5 OVERFLOW interrupt
73 PWM5_CHANNEL (PWM5) — PWM5 CHANNEL interrupt
74 PWM5_FAULT (PWM5) — PWM5 FAULT interrupt
81 RTC — RTC Interrupt
82 PCT — PCT interrupt
83 TIMER_CHANNEL0 (TIMER_CHANNEL) — TIMER channel 0 interrupt
84 TIMER_CHANNEL1 — TIMER channel 1 interrupt
85 TIMER_CHANNEL2 — TIMER channel 2 interrupt
86 TIMER_CHANNEL3 — TIMER channel 3 interrupt
88 FLASH_ECC (FLASH) — FLASH ECC 2-bit error interrupt
89 FLASH — FLASH command complete interrupt
90 FLASH_COLLISION (FLASH) — FLASH Collision interrupt
91 ECC_SRAM_1BIT_ERROR (ECC_SRAM) — ECC SRAM 1bit error interrupt
92 ECC_SRAM_2BIT_ERROR (ECC_SRAM) — ECC SRAM 2bit error interrupt

## Licence text in the file
Copyright Statement: . This software/firmware and related documentation ("AutoChips Software") are protected under relevant copyright laws. The information contained herein is confidential and proprietary to AutoChips Inc. and/or its licensors. Without the prior written permission of AutoChips inc. and/or its licensors, any reproduction, modification, use or disclosure of AutoChips Software, and information contained herein, in whole or in part, shall be strictly prohibited. . AutoChips Inc. (C) 2020. All rights reserved. . BY OPENING THIS FILE, RECEIVER HEREBY UNEQUIVOCALLY ACKNOWLEDGES AND AGREES. THAT THE SOFTWARE/FIRMWARE AND ITS DOCUMENTATIONS ("AUTOCHIPS SOFTWARE"). RECEIVED FROM AUTOCHIPS AND/OR ITS REPRESENTATIVES ARE PROVIDED TO RECEIVER. ON AN "AS-IS" BASIS ONLY. AUTOCHIPS EXPRESSLY DISCLAIMS ANY AND ALL. WARRANTIES, EXPRESS OR IMPLIED, INCLUDING BUT NOT LIMITED TO THE IMPLIED. WARRANTIES OF MERCHANTABILITY, FITNESS FOR A PARTICULAR PURPOSE OR. NONINFRINGEMENT. NEITHER DOES AUTOCHIPS PROVIDE ANY WARRANTY WHATSOEVER WITH. RESPECT TO THE SOFTWARE OF ANY THIRD PARTY WHICH MAY BE USED BY, INCORPORATED IN, OR SUPPLIED WITH THE AUTOCHIPS SOFTWARE, AND RECEIVER AGREES. TO LOOK ONLY TO SUCH THIRD PARTY FOR ANY WARRANTY CLAIM RELATING THERETO. RECEIVER EXPRESSLY ACKNOWLEDGES THAT IT IS RECEIVER'S SOLE RESPONSIBILITY TO. OBTAIN FROM ANY THIRD PARTY ALL PROPER LICENSES CONTAINED IN AUTOCHIPS. SOFTWARE. AUTOCHIPS SHALL ALSO NOT BE RESPONSIBLE FOR ANY AUTOCHIPS SOFTWARE. RELEASES MADE TO RECEIVER'S SPECIFICATION OR TO CONFORM TO A PARTICULAR. STANDARD OR OPEN FORUM. RECEIVER'S SOLE AND EXCLUSIVE REMEDY AND AUTOCHIPS'S. ENTIRE AND CUMULATIVE LIABILITY WITH RESPECT TO THE AUTOCHIPS SOFTWARE. RELEASED HEREUNDER WILL BE, AT AUTOCHIPS'S OPTION, TO REVISE OR REPLACE THE. AUTOCHIPS SOFTWARE AT ISSUE, OR REFUND ANY SOFTWARE LICENSE FEES OR SERVICE. CHARGE PAID BY RECEIVER TO AUTOCHIPS FOR SUCH AUTOCHIPS SOFTWARE AT ISSUE.
